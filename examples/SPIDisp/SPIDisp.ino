#include <SPI.h> // SPIライブラリをインクルードする
#include "ST7735Lib.h"

#define MAX_TOKEN_LENGTH 32 // 各文字列の最大長

void splitString(const char *input, char output[][MAX_TOKEN_LENGTH], int *count) {
    char buffer[MAX_TOKEN_LENGTH];
    int i = 0, j = 0, token_count = 0;

    while (*input != '\0') {
        if (*input == ',') {
            buffer[j] = '\0';
            strcpy(output[token_count], buffer);
            token_count++;
            j = 0;
        } else {
            buffer[j++] = *input;
        }
        input++;
    }
    buffer[j] = '\0';
    strcpy(output[token_count], buffer);
    token_count++;

    *count = token_count;
}

// Bitmap data
const uint16_t sharaku[] = {0x0821,0x0821,0x0821,0x0821,0x0821,0x0821,0x0821,0x0821,0x0821,0x0821,0x0821,0x0821,0x0821,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0x0821,
0x0821,0x0821,0x0821,0x0821,0x0821,0x0821,0x0821,0x0821,0x0821,0x0821,0x0821,0x0821,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0x0821,
0x0821,0x0821,0x0821,0x0821,0x0821,0x0821,0x0821,0x0821,0x0821,0x0821,0x0821,0x0821,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0x0821,
0x0821,0x0821,0x0821,0x0821,0x0821,0x0821,0x0821,0x0821,0x0821,0x0821,0x0821,0x0821,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0x0821,
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0x844C,0x6B48,0x7349,0x7369,0x6B49,0x6B69,0x7369,0x6B49,0x6B69,0x6B69,0x6B68,0x7389,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0x0821,0x0821};


// SPI転送モード
SPISettings  spisettings(1000000, MSBFIRST, SPI_MODE3); // SPI通信の設定を作成する
const int SPI_PORT = 0;
const int RXDC_PIN = 16;
const int CS_PIN = 17;
const int SCK_PIN = 18;
const int MOSI_PIN = 19;
const int RESET_PIN = 0;
const int DEBUG_PIN = 0;
ST7735 *pST7735;
ST7735 st7735;

HW spiHW(SPI_PORT, RXDC_PIN, CS_PIN, SCK_PIN, MOSI_PIN, RESET_PIN, DEBUG_PIN);

void setup() {
    // These functions are defined in Raspberry PI PICO SDK
    spi_init(spiHW.portSPI, 10*1000*1000);	
  	gpio_set_function(spiHW._dc, GPIO_FUNC_SPI);
    gpio_set_function(spiHW._sck,GPIO_FUNC_SPI);
    gpio_set_function(spiHW._tx, GPIO_FUNC_SPI);
    gpio_put(spiHW._cs,1);

    spiHW.init();
    st7735.SetSPIHW(&spiHW);
    st7735.doInit();
}


void loop() {
    // 登録済みのフォントの一覧を求める。登録済みフォントはST7735_TFT.cppの、doInitで登録してある。変更時は、
    // どこかからフォントを持ってきて、include\fontに突っ込んで、doInitで登録する。
      char buf[256];
    	st7735.getFonts(buf,sizeof(buf));
      int  count;
      char fonts[32][MAX_TOKEN_LENGTH];
      splitString(buf,fonts,&count);



    st7735.fillScreen(ST7735Color.BLACK);
    st7735.drawTextKanji(0,0,"日本語表示ライブラリ",ST7735Color.WHITE, ST7735Color.BLACK, 1);
    st7735.drawTextKanji(0,20,"日本語とスクロール",ST7735Color.WHITE, ST7735Color.BLACK, 1);

    delay(1000); 
    
    {
      st7735.fillScreen(ST7735Color.BLACK);
      st7735.drawTextKanji(0,0,"祇園精舎の鐘の聲、諸行無常の響あり。沙羅双樹の花の色、盛者必衰の理をあらはす。驕れる人も久しからず、唯春の夜の夢の如し。猛き者もつひには滅びぬ、偏に風の前の塵に同じ。",ST7735Color.WHITE, ST7735Color.BLACK, 1);
      delay(1000); 
	    for (int i = 0; i < st7735.getHeight(); i++) {
		    st7735.setScrollDefinition(0, 0, true);
		    st7735.verticalScroll(i);
		    sleep_ms(10);
	    }
	    st7735.verticalScroll(0);
      delay(1000); 

      st7735.st7735Init.setRotation(ST7735_ROTATION::DEGREE_90);
	    st7735.fillScreen(ST7735Color.WHITE);
      st7735.drawTextKanji(0,0,"春はあけぼの。やうやう白くなりゆく山ぎは少し明りて、紫だちたる雲の細くたなびきたる。夏は夜。月の頃はさらなり。闇もなほ。螢の多く飛び違ひたる。また、ただ一つ二つなど、ほのかにうち光りて行くもをかし。雨など降るもをかし。",ST7735Color.BLACK, ST7735Color.WHITE, 1);
      delay(1000); 
	    for (int i = 0; i < st7735.getHeight(); i++) {
		    st7735.setScrollDefinition(0, 0, false);
		    st7735.verticalScroll(i);
		    sleep_ms(10);
	    }
	    st7735.verticalScroll(0);
      delay(1000); 
      st7735.st7735Init.setRotation(ST7735_ROTATION::NORMAL);
    }
    {
      st7735.fillScreen(ST7735Color.BLACK);
      st7735.drawTextKanji(0,0,"日本語表示ライブラリ",ST7735Color.WHITE, ST7735Color.BLACK, 1);
      st7735.drawTextKanji(0,20,"英文フォント",ST7735Color.WHITE, ST7735Color.BLACK, 1);    
      st7735.drawTextKanji(0,40,"固定領域スクロール",ST7735Color.WHITE, ST7735Color.BLACK, 1);    
      delay(1000); 
      st7735.fillScreen(ST7735Color.BLACK);
      st7735.setFont(fonts[0]);
      st7735.fillRectangle(0, 0, st7735.getWidth(), 15, ST7735Color.WHITE);
      st7735.fillRectangle(0, st7735.getHeight()-15, st7735.getWidth(), 15, ST7735Color.WHITE);
	    st7735.drawText(0, 13, "FIXED AREA", ST7735Color.BLACK, ST7735Color.WHITE, 1);
	    st7735.drawText(0, st7735.getHeight() - 3, "FIXED AREA", ST7735Color.BLACK, ST7735Color.WHITE, 1);


      st7735.setFont(fonts[3]);
	    const char* txt = "The quick brown fox jumps over the lazy dog";
    	st7735.drawText(0, 30, txt, ST7735Color.WHITE, ST7735Color.BLACK, 1);
  	  st7735.setScrollDefinition(15, 15, true);

		  for (int i = 15; i < st7735.getHeight() - 15; i++) {
			  st7735.verticalScroll(i);
			  sleep_ms(10);
		  }
		  st7735.verticalScroll(0);
      st7735.setScrollDefinition(0, 0, true);      
    	st7735.SetRotation(ST7735_ROTATION::NORMAL);            //　スクロール領域指定後は、これがないとなぜか画面の色が変になる
      delay(1000);   
    }



    {
      st7735.fillScreen(ST7735Color.WHITE);
      st7735.drawTextKanji(0,0,"ﾋﾞｯﾄﾏｯﾌﾟ(透過なし)",ST7735Color.BLACK, ST7735Color.WHITE, 1);
      for (int i=0;i<10;i++) {
    	  st7735.bmpDraw(rand() % (st7735.getWidth() - 50), rand() % (st7735.getHeight() - 120)+24, 48, 77, (uint16_t*)sharaku, 0);
      }
      delay(1000);   
    }

    {
      st7735.bmpUseTransColor(0b0000100000100001);	// 透過あり
      st7735.drawTextKanji(0,0,"ﾋﾞｯﾄﾏｯﾌﾟ(透過あり)",ST7735Color.BLACK, ST7735Color.WHITE, 1);
      for (int i=0;i<4;i++) st7735.fillRect(i*32,16,i*32+16,st7735.getHeight(),ST7735Color.RED);
      for (int i=0;i<4;i++) st7735.fillRect(i*32+16,16,i*32+32,st7735.getHeight(),ST7735Color.WHITE);
      for (int i=0;i<10;i++) {
    		st7735.bmpDraw(rand() % (st7735.getWidth() - 50), rand() % (st7735.getHeight() - 120)+24, 48, 77, (uint16_t*)sharaku, 0);
      }
      st7735.bmpUnuseTransColor();
      delay(1000); 
    }

    {
      st7735.fillScreen(ST7735Color.BLACK);
      st7735.drawTextKanji(0,0,"矩形",ST7735Color.WHITE, ST7735Color.BLACK, 1);

      for (int i=0;i<10;i++) {
        int c = rand() % 0xFFFF;
        st7735.drawRect(i*5 , 16+i*5, st7735.getWidth()-i*5,st7735.getHeight()-i*5,c);
      }
      delay(1000); 
    }

    {
      st7735.fillScreen(ST7735Color.BLACK);
      st7735.drawTextKanji(0,0,"塗りつぶし矩形",ST7735Color.WHITE, ST7735Color.BLACK, 1);
      for (int i=0;i<10;i++) {
        int c = rand() % 0xFFFF;
        st7735.fillRect(i*5 , 16+i*5, st7735.getWidth()-i*5,st7735.getHeight()-i*5,c);
      }
      delay(1000); 
    }

    {
      st7735.fillScreen(ST7735Color.BLACK);
      st7735.drawTextKanji(0, 0, "円・塗りつぶし円", ST7735Color.WHITE, ST7735Color.BLACK, 1);

      const int numCircles = 5;
      int x[numCircles];
      int y[numCircles];
      int dx[numCircles];
      int dy[numCircles];
      uint16_t colors[numCircles];

      // ランダムな初期位置と速度を設定
      randomSeed(analogRead(0)); // ランダムシードを初期化
      for (int i = 0; i < numCircles; i++) {
        x[i] = random(10, st7735.getWidth() - 10); // 範囲: 10〜(幅-10)
        y[i] = random(26, st7735.getHeight() - 10); // 範囲: 26〜(高さ-10)
        dx[i] = random(0, 2) == 0 ? 4 : -4; // ランダムな方向
        dy[i] = random(0, 2) == 0 ? 4 : -4; // ランダムな方向
        colors[i] = random(0, 0xFFFF);
      }

      // 円を動作させる
      for (int i = 0; i < 200; i++) {
        for (int j = 0; j < numCircles; j++) {
          // 現在の円を消す
          if (i < 100) {
            st7735.drawCircle(x[j], y[j],8, ST7735Color.BLACK);
          } else {
            st7735.fillCircle(x[j], y[j],8, ST7735Color.BLACK);
          }          // 位置を更新

          // 画面の端で跳ね返る
          if (x[j] >= (st7735.getWidth() - 5) || x[j] <= 5) dx[j] = -dx[j];
          if (y[j] >= (st7735.getHeight() - 5) || y[j] <= 20) dy[j] = -dy[j];

          x[j] += dx[j];
          y[j] += dy[j];
          if (i < 100) {
            st7735.drawCircle(x[j], y[j], 8, colors[j]);
          } else {
            st7735.fillCircle(x[j], y[j], 8, colors[j]);
          }
        }
        delay(20);
      }
    }
    delay(1000); 
    {
      st7735.fillScreen(ST7735Color.BLACK);
      st7735.drawTextKanji(0, 0, "三角形", ST7735Color.WHITE, ST7735Color.BLACK, 1);

      int16_t centerX = st7735.getWidth()/2;
      int16_t centerY = st7735.getHeight()/2;
      int radiusIncrement = 5; // 半径の増加量
      int initialRadius = 20;   // 初期半径

      for (int i = 0; i < 10; i++) {
        int radius = initialRadius + i * radiusIncrement;
        // 三角形の頂点座標を計算
        int16_t x0 = centerX + radius * cos(0 * PI / 180);    // 上の頂点
        int16_t y0 = centerY + radius * sin(0 * PI / 180);
        int16_t x1 = centerX + radius * cos(120 * PI / 180);  // 左下の頂点
        int16_t y1 = centerY + radius * sin(120 * PI / 180);
        int16_t x2 = centerX + radius * cos(240 * PI / 180);  // 右下の頂点
        int16_t y2 = centerY + radius * sin(240 * PI / 180);

        // 三角形を描画
        st7735.drawTriangle(x0, y0, x1, y1, x2, y2, random(0, 0xFFFF)); // 色は10色を循環
      }
      delay(1000);
    }

    {
      st7735.fillScreen(ST7735Color.BLACK);
      st7735.drawTextKanji(0, 0, "塗りつぶし三角形", ST7735Color.WHITE, ST7735Color.BLACK, 1);

      int16_t centerX = st7735.getWidth()/2;
      int16_t centerY = st7735.getHeight()/2;
      int radiusIncrement = 5; // 半径の増加量
      int initialRadius = 20;   // 初期半径

      for (int i = 0; i < 10; i++) {
        int radius = initialRadius + i * radiusIncrement;
        // 三角形の頂点座標を計算
        int16_t x0 = centerX + radius * cos(0 * PI / 180);    // 上の頂点
        int16_t y0 = centerY + radius * sin(0 * PI / 180);
        int16_t x1 = centerX + radius * cos(120 * PI / 180);  // 左下の頂点
        int16_t y1 = centerY + radius * sin(120 * PI / 180);
        int16_t x2 = centerX + radius * cos(240 * PI / 180);  // 右下の頂点
        int16_t y2 = centerY + radius * sin(240 * PI / 180);

        // 三角形を描画
        st7735.fillTriangle(x0, y0, x1, y1, x2, y2, random(0, 0xFFFF)); // 色は10色を循環
      }
    }

    {
      st7735.fillScreen(ST7735Color.BLACK);
      st7735.drawTextKanji(0,30,"詳しい使い方やカスタマイズ方法については、https://qiita.com/BUBUBB/items/3caf2aefba4ae3a715e1 を参照してください",ST7735Color.WHITE, ST7735Color.BLACK, 1);

      st7735.setFont(fonts[1]);
      st7735.bmpUseTransColor(0x0001);
      st7735.drawText(11,21,"<END>",ST7735Color.GRAY, 0x0001, 1);
      st7735.drawText(11,20,"<END>",ST7735Color.GRAY, 0x0001, 1);
      st7735.drawText(11,21,"<END>",ST7735Color.GRAY, 0x0001, 1);
      st7735.drawText(10,20,"<END>",ST7735Color.WHITE, 0x0001, 1);
      st7735.bmpUnuseTransColor();
    }
    delay(1000);         
}
